## config/west.yml
```yaml
manifest:
  remotes:
    - name: zmkfirmware
      url-base: https://github.com/zmkfirmware
    - name: razilyis
      url-base: https://github.com/razilyis
    - name: caksoylar
      url-base: https://github.com/caksoylar
  projects:
    - name: zmk
      remote: zmkfirmware
      revision: v0.2.1
      import: app/west.yml
    - name: zmk-pmw3610-driver
      remote: razilyis
      revision: main
    - name: zmk-rgbled-widget
      remote: caksoylar
      revision: e9472d6c59b8e901753dfa6c337c1b24cb70f571
  self:
    path: config
```
